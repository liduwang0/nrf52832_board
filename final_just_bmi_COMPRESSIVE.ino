#include <nrf_soc.h>
#include "lp_BLESerial.h"
#include "mysht40.h"
#include <SPI.h>
#include <Wire.h>
#include "bmi2xx.h"

#include "Arduino.h"
#include "SD.h"
#include "mycompress.h"
#include <ArduinoEigenDense.h>


using namespace Eigen;
using Eigen::MatrixXf;
MYCOMPRESS compress_data;

String buffer = "";

int16_t loop_counter_for_compressive_sensing = 0;
int gyr_detecter = 0;
long motion_sensor_time_interval = 80;

long interval_T1_BLE = 5;
long interval_T3_SHT40 = 5000;
long interval_T4_BMI270 = motion_sensor_time_interval;


bool bmiflag = 0;

unsigned long prevTime_T1 = millis();
unsigned long prevTime_T3 = millis();
unsigned long prevTime_T4 = millis();
bool shtflag = 0;

int automatical_time_interval_counter = 0;


uint8_t automatical_time_interval_function_switch = 0x00;
bool t_and_h_output_switch = 0;
bool compress_switch = 0;


int offset = 0;
File my_sd_File;

MYSHT40 sht;


// int config_runtime_flag = 0;
uint8_t bmi_pwr_control;  // 0

uint8_t acc_range_control;  // 1
uint8_t gyr_range_control;  // 2
uint8_t bmi_acc_config;     // 3
uint8_t bmi_gyr_config;

uint8_t compressive_sensing_control;  // 4
uint8_t data_compression_control;     // 5


uint8_t te_hu_control;     // 6
uint8_t infrared_control;  // 7

int config_from_ble_counter = 0;  //因为收到的数字我需要++ ，总不能加到7 8 9把，每次到+到6的时候就会清零。从头开始储存参数

uint8_t received_config_from_ble[8];
int new_256buffer[256][6];

int compressive_sensed[64];
lp_BLESerial blePeripheral;




BLEService sensorConfigService = BLEService("19B10000-E8F2-537E-4F6C-D104768A1214");

// create switch characteristic
BLECharCharacteristic bmi_pwr_Characteristic = BLECharCharacteristic("19B10001-E8F2-537E-4F6C-D104768A1214", BLERead | BLEWrite);
BLECharCharacteristic acc_range_Characteristic = BLECharCharacteristic("19B10002-E8F2-537E-4F6C-D104768A1214", BLERead | BLEWrite);
BLECharCharacteristic gyr_range_Characteristic = BLECharCharacteristic("19B10003-E8F2-537E-4F6C-D104768A1214", BLERead | BLEWrite);
BLECharCharacteristic bmi_hz_Characteristic = BLECharCharacteristic("19B10004-E8F2-537E-4F6C-D104768A1214", BLERead | BLEWrite);
BLECharCharacteristic compressive_sensing_Characteristic = BLECharCharacteristic("19B10005-E8F2-537E-4F6C-D104768A1214", BLERead | BLEWrite);
BLECharCharacteristic data_compression_Characteristic = BLECharCharacteristic("19B10006-E8F2-537E-4F6C-D104768A1214", BLERead | BLEWrite);
BLECharCharacteristic te_hu_Characteristic = BLECharCharacteristic("19B10007-E8F2-537E-4F6C-D104768A1214", BLERead | BLEWrite);
BLECharCharacteristic infrared_Characteristic = BLECharCharacteristic("19B10008-E8F2-537E-4F6C-D104768A1214", BLERead | BLEWrite);


BLEService Start_Service = BLEService("f2783635-3a07-4a51-9696-459ae784363e");  // 我发现只要一个lp_BLESerial blePeripheral就够了。我两个ttribute，到时候收到消息可以分辨是哪里收到了消息


BLECharCharacteristic Start_Characteristic = BLECharCharacteristic("f2783636-3a07-4a51-9696-459ae784363e", BLERead | BLEWrite);


String sd_filename = "where_is_my_name.CSV";
unsigned int BMI_chip_ID;
int file_count;
int config_size;
int BMI_init_status;
int BMI_power_mode;
BMI2xx bmi2xx;
Eigen::Matrix<float, 48, 64> matrix48;

void setup() {
  //32 行和 64 列的矩阵,只能放在setup()，其他地方不行
  matrix48 << -0.00046394, -0.0010105, -0.0022278, 0.0012662, 0.002441, -0.00088115, -0.0031043, -0.0018578, 0.0015302, 0.0027551, 0.0032006, -0.0043303, 0.00010832,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 0.001479,
    -0.0025752, 0.00019431, -0.0060613, -0.0063601, 0.0017507, -0.0058405, -0.00054918, -0.0025442, -0.0018343, 0.0012854, -0.0016841, 0.00048473,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 -0.0024217,
    -0.0012308, 0.0004006, -0.0080574, -0.0033228, -0.00080558, -0.0010497, -0.0033557, -0.0021939, -0.0012544, 0.001742, 0.002152, 0.00068632,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 0.0001034,
    -0.0013084, -0.0007981, 0.0016957, 0.0042431, -0.0025916, -0.0042107, 0.00062451, 0.00027221, 0.00089646, -0.0016184, 0.0047996, -0.0066933,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 0.00037773,
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    0.0019425, -0.00041936, -0.0020766, -0.0011827, -0.0068367, -0.0032135, -0.0018309, -0.0016689, -0.004531, -0.0036894, -0.0017974, -0.0025835,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 -0.00025023, 0.0004367;

  sd_power_dcdc_mode_set(NRF_POWER_DCDC_ENABLE);
  // put your setup code here, to run once:
  Serial.begin(115200);
  NRFSetup_Callback();
  BLESetup_Callback();
  delay(50);
  Serial.println("setup finished");
}

void loop() {

  // put your main code here, to run repeatedly:
  unsigned long currentTime = millis();

  // Task 1 : Blink LED1 (T1)
  if (currentTime - prevTime_T1 > interval_T1_BLE) {

    BLECentral central = blePeripheral.central();
    if (central) {
      if (blePeripheral.available()) {
        digitalWrite(13, LOW);
        String receivedMessage = blePeripheral.readString();
        Serial.print("Received message: ");
        Serial.println(receivedMessage);
        receivedMessage.remove(receivedMessage.length() - 1);  // 这里必去去掉最后一个元素，我从mit2app收到的最后一个元素不知道是什么，但是由于这个元素，导致我储存的数据csv前两行会有便宜。应该是最后这个休止符导致的
        sd_filename = receivedMessage;
        offset = 0;  // 原来bug在这里，当我更改文件名的时候，需要把offset清零，不然是从上次断点开始计数，比如从200开始存数据，那么前面两百可能就有坏数据
        //每次改名字的时候打头，，汇报暂时不加
        //   SD.begin(27);

        // Serial.println("rename");
        // my_sd_File = SD.open(sd_filename, FILE_WRITE);

        // if (my_sd_File) {
        //   String csv_file_name = "stamp,bmi_acc_x,bmi_acc_y,bmi_acc_z,bmi_gyr_x,bmi_gyr_y,bmi_gyr_z,adxl_x,adxl_y,adxl_z\n";
        //   my_sd_File.write(csv_file_name.c_str(), csv_file_name.length());


        //   my_sd_File.close();  //

        // }






        // if (receivedMessage[0] == 'F') {  // 这里居然只能单引号

        //   Serial.print("File name is: ");
        //   Serial.println(receivedMessage.substring(2));
        //   sd_filename = receivedMessage.substring(2).c_str();
        //   sd_filename_store_outside_loop = sd_filename;
        //   Serial.print("varialble is: ");
        //   Serial.println(sd_filename);
        // }
        digitalWrite(13, HIGH);
      }

      // central still connected to peripheral

      if (bmi_pwr_Characteristic.written()) {
        digitalWrite(13, LOW);
        received_config_from_ble[0] = bmi_pwr_Characteristic.value();
      }
      if (acc_range_Characteristic.written()) {
        received_config_from_ble[1] = acc_range_Characteristic.value();
      }
      if (gyr_range_Characteristic.written()) {
        received_config_from_ble[2] = gyr_range_Characteristic.value();
      }
      if (bmi_hz_Characteristic.written()) {
        received_config_from_ble[3] = bmi_hz_Characteristic.value();
      }
      if (compressive_sensing_Characteristic.written()) {
        received_config_from_ble[4] = compressive_sensing_Characteristic.value();
      }
      if (data_compression_Characteristic.written()) {
        received_config_from_ble[5] = data_compression_Characteristic.value();
      }
      if (te_hu_Characteristic.written()) {
        received_config_from_ble[6] = te_hu_Characteristic.value();
      }
      if (infrared_Characteristic.written()) {
        received_config_from_ble[7] = infrared_Characteristic.value();
        Serial.print("Current config:  ");
        for (int i = 0; i < 8; i++) {
          Serial.print(received_config_from_ble[i], HEX);
          Serial.print(" ");
        }
        Serial.println(" ");
        config_all_sensors();
        digitalWrite(13, HIGH);  // 放这里最合适，因为每次点了config device收到数据就直接配置了，不用去action开头判断 配置不配置
      }


      if (Start_Characteristic.written()) {
        // Serial.print(Start_Characteristic.value(), HEX);
        // Serial.println(" ");
        if (Start_Characteristic.value() == 0x01) {



          bmiflag = 1;

          // Serial.println("sht.on_or_off_status");
          // Serial.println(sht.on_or_off_status);
          // if (sht.on_or_off_status == 1) {
          //   runner.addTask(Sht40_Action);        // if等以后添加。因为这里添加后会失去一个功能，读取数据的时候不能配置device。
          //   Sht40_Action.enable();
          // }

          shtflag = 1;
        }
        if (Start_Characteristic.value() == 0x00) {

          bmiflag = 0;


          shtflag = 0;

          // config_runtime_flag = 0;


          //                       pinMode(24, OUTPUT);
          // digitalWrite(24, LOW);
          //               pinMode(9, OUTPUT);
          // digitalWrite(9, LOW);
          //       pinMode(10, OUTPUT);
          // digitalWrite(10, LOW);
          //  Wire.end();
        }
      }
      // Send a message over BLE
      // bleSerial.println("Hello from NRF52832!");
      //dummy, ble is high frequency, set up other dummy tasks

      // delay(1);
    }

    prevTime_T1 = currentTime;
  }

  // Task 2 : Glow LED2 when BTN is pressed
  if (((currentTime - prevTime_T3) > interval_T3_SHT40) && (shtflag == 1)) {
    if (t_and_h_output_switch == 1) {
      Sht40_Action_Callback();
      prevTime_T3 = currentTime;
    }
  }

  // Task 3 : Read input from serial monitor (0-255) and then write to LED3


  // Task 4 : print the brightness of LED3 in the serial monitor after every 5 seconds
  if (((currentTime - prevTime_T4) > interval_T4_BMI270) && (bmiflag == 1)) {
    unsigned long offset1 = 0;  // 时间偏移量
    unsigned long currentTime = millis();


    unsigned long startTime = micros();  // 记录开始时间
    // 执行一些代码




    // pinMode(22, OUTPUT);  //打开IC开关
    // digitalWrite(22, LOW);

    // if (config_runtime_flag == 0) {
    //   config_all_sensors();  //我发现放在BLEaction也不行，以为可能还没执行到这个函数，BMI_ADXL_Action就开始执行了，所以导致没有输出，我必须保证在读取前执行这个配置所以只有一种办法，
    //                          //使用BMI_ADXL_Action的时候调用这个一次，只能一次，不然一直配置，然后用flag表示执行过，当我按了stop，flag为0，下次执行BLE ACTIOND的时候又会仅仅配置一次
    //   config_runtime_flag = 1;
    // }


    SPI.setDataMode(SPI_MODE3);







    int16_t acc_x, acc_y, acc_z, gyr_x, gyr_y, gyr_z;
    uint8_t lsb_acc_x, msb_acc_x, lsb_acc_y, msb_acc_y, lsb_acc_z, msb_acc_z;  //比如从both更改为acc之后，gyr有前一次的值，我想变为0，我把这里所有给了初始值，但是我发现还是不等于0
    uint8_t lsb_gyr_x, msb_gyr_x, lsb_gyr_y, msb_gyr_y, lsb_gyr_z, msb_gyr_z;
    // Burst data read from ACC_x_0_7 to Gyr_8_13
    byte dataToSend = accel_gyr_addr | READ;

    digitalWrite(14, LOW);
    SPI.transfer(dataToSend);  //Send register location
    SPI.transfer(0x00);
    lsb_acc_x = SPI.transfer(0x00);
    msb_acc_x = SPI.transfer(0x00);
    lsb_acc_y = SPI.transfer(0x00);
    msb_acc_y = SPI.transfer(0x00);
    lsb_acc_z = SPI.transfer(0x00);
    msb_acc_z = SPI.transfer(0x00);

    lsb_gyr_x = SPI.transfer(0x00);
    msb_gyr_x = SPI.transfer(0x00);
    lsb_gyr_y = SPI.transfer(0x00);
    msb_gyr_y = SPI.transfer(0x00);
    lsb_gyr_z = SPI.transfer(0x00);
    msb_gyr_z = SPI.transfer(0x00);
    digitalWrite(14, HIGH);

    acc_x = ((int16_t)msb_acc_x << 8) | (int16_t)lsb_acc_x;
    acc_y = ((int16_t)msb_acc_y << 8) | (int16_t)lsb_acc_y;
    acc_z = ((int16_t)msb_acc_z << 8) | (int16_t)lsb_acc_z;

    gyr_x = ((int16_t)msb_gyr_x << 8) | (int16_t)lsb_gyr_x;
    gyr_y = ((int16_t)msb_gyr_y << 8) | (int16_t)lsb_gyr_y;
    gyr_z = ((int16_t)msb_gyr_z << 8) | (int16_t)lsb_gyr_z;

    Serial.print("acc_x = ");
    Serial.print(acc_x);
    Serial.print("\t");

    Serial.print("acc_y = ");
    Serial.print(acc_y);
    Serial.print("\t");

    Serial.print("acc_z = ");
    Serial.print(acc_z);
    Serial.print("\t");

    Serial.print("gyr_x = ");
    Serial.print(gyr_x);
    Serial.print("\t");

    Serial.print("gyr_y = ");
    Serial.print(gyr_y);
    Serial.print("\t");

    Serial.print("gyr_z = ");
    Serial.print(gyr_z);
    Serial.print("\t");

    Serial.println("");
    unsigned long endTime = micros();  // 记录结束时间

    unsigned long elapsedTime = endTime - startTime;  // 计算运行时间




    // Serial.print("BMI ST:");
    // BMI_init_status = bmi2xx.readRegister(INT_STATUS, 2);
    // Serial.println(BMI_init_status);




    //  Serial.print("sdname=");
    //Serial.print(sd_filename);



    int16_t input_data[6] = { acc_x, acc_y, acc_z, gyr_x, gyr_y, gyr_z };
    int input_data_size = sizeof(input_data) / sizeof(input_data[0]);

    new_256buffer[loop_counter_for_compressive_sensing][0] = acc_x;
    new_256buffer[loop_counter_for_compressive_sensing][1] = acc_y;
    new_256buffer[loop_counter_for_compressive_sensing][2] = acc_z;
    new_256buffer[loop_counter_for_compressive_sensing][3] = gyr_x;
    new_256buffer[loop_counter_for_compressive_sensing][4] = gyr_y;
    new_256buffer[loop_counter_for_compressive_sensing][5] = gyr_z;


    loop_counter_for_compressive_sensing++;
    Serial.println(loop_counter_for_compressive_sensing);

    if (data_compression_control == 1) {
      int8_t* compressed_data = compress_data.scaleArray(input_data, input_data_size);
      for (int i = 0; i < 6; i++) {
        input_data[i] = compressed_data[i];
      }
    }





    //必须很大，不然会出现乱码
    // Serial.println("CURRENT TIME.");
    // Serial.println(currentTime);
    // offset += sprintf(buffer + offset, "%lu", currentTime);
    // offset += sprintf(buffer + offset, ",");

    // for (int i = 0; i < 9; i++) {  //这里不能是sizeof input，不然数据是16个
    //   offset += sprintf(buffer + offset, "%d", input_data[i]);

    //   // Add comma delimiter for all elements except the last one
    //   if (i < 8) {
    //     offset += sprintf(buffer + offset, ",");
    //   }
    // }

    if (loop_counter_for_compressive_sensing == 256) {
      long starthaha_time = millis();
      for (int i = 0; i < 256; i++) {
        for (int j = 0; j < 6; j++) {
          Serial.print(new_256buffer[i][j]);
          Serial.print(" ");  // 打印空格以使输出更易读
        }
        Serial.println();  // 在每行结束后打印一个换行符
      }
      Serial.println("whole csv print over");
      for (int i = 0; i < 256; i++) {
        Serial.print(new_256buffer[i][0]);
        Serial.print(" ");  // 打印空格以使输出更易读
      }
      Serial.println();  // 在每行结束后打印一个换行符

      Eigen::Matrix<float, 256, 6> mat;

      for (int i = 0; i < 256; i++) {
        for (int j = 0; j < 6; j++) {
          mat(i, j) = new_256buffer[i][j];
        }
      }

      
      SD.begin(27);

      Serial.println("write successfully...");
      Serial.println(sd_filename);
      my_sd_File = SD.open("popo.csv", FILE_WRITE);

      if (my_sd_File) {

        for(int i = 0; i < mat.rows(); ++i) {
      for(int j = 0; j < mat.cols(); ++j) {
        my_sd_File.print(mat(i, j));
        if (j < mat.cols() - 1) {
          my_sd_File.print(","); // 在元素之间添加逗号
        }
      }
      if(i < mat.rows() - 1) {
        my_sd_File.println(); // 在行之间添加换行符
      }
    }
   my_sd_File.close(); // 关闭文件
      }

      int segment_size = 64;

      Eigen::VectorXf segment_acc_x = mat.col(0);  // 提取第一列
      Eigen::VectorXf seg_acc_x_1 = segment_acc_x.segment(0 * segment_size, segment_size);
      Eigen::VectorXf seg_acc_x_2 = segment_acc_x.segment(1 * segment_size, segment_size);
      Eigen::VectorXf seg_acc_x_3 = segment_acc_x.segment(2 * segment_size, segment_size);
      Eigen::VectorXf seg_acc_x_4 = segment_acc_x.segment(3 * segment_size, segment_size);

      Eigen::VectorXf segment_acc_y = mat.col(1);  // 提取第一列
      Eigen::VectorXf seg_acc_y_1 = segment_acc_y.segment(0 * segment_size, segment_size);
      Eigen::VectorXf seg_acc_y_2 = segment_acc_y.segment(1 * segment_size, segment_size);
      Eigen::VectorXf seg_acc_y_3 = segment_acc_y.segment(2 * segment_size, segment_size);
      Eigen::VectorXf seg_acc_y_4 = segment_acc_y.segment(3 * segment_size, segment_size);

      Eigen::VectorXf segment_acc_z = mat.col(2);  // 提取第一列
      Eigen::VectorXf seg_acc_z_1 = segment_acc_z.segment(0 * segment_size, segment_size);
      Eigen::VectorXf seg_acc_z_2 = segment_acc_z.segment(1 * segment_size, segment_size);
      Eigen::VectorXf seg_acc_z_3 = segment_acc_z.segment(2 * segment_size, segment_size);
      Eigen::VectorXf seg_acc_z_4 = segment_acc_z.segment(3 * segment_size, segment_size);

      Eigen::VectorXf segment_gyr_x = mat.col(3);  // 提取第一列
      Eigen::VectorXf seg_gyr_x_1 = segment_gyr_x.segment(0 * segment_size, segment_size);
      Eigen::VectorXf seg_gyr_x_2 = segment_gyr_x.segment(1 * segment_size, segment_size);
      Eigen::VectorXf seg_gyr_x_3 = segment_gyr_x.segment(2 * segment_size, segment_size);
      Eigen::VectorXf seg_gyr_x_4 = segment_gyr_x.segment(3 * segment_size, segment_size);

      Eigen::VectorXf segment_gyr_y = mat.col(4);  // 提取第一列
      Eigen::VectorXf seg_gyr_y_1 = segment_gyr_y.segment(0 * segment_size, segment_size);
      Eigen::VectorXf seg_gyr_y_2 = segment_gyr_y.segment(1 * segment_size, segment_size);
      Eigen::VectorXf seg_gyr_y_3 = segment_gyr_y.segment(2 * segment_size, segment_size);
      Eigen::VectorXf seg_gyr_y_4 = segment_gyr_y.segment(3 * segment_size, segment_size);

      Eigen::VectorXf segment_gyr_z = mat.col(5);  // 提取第一列
      Eigen::VectorXf seg_gyr_z_1 = segment_gyr_z.segment(0 * segment_size, segment_size);
      Eigen::VectorXf seg_gyr_z_2 = segment_gyr_z.segment(1 * segment_size, segment_size);
      Eigen::VectorXf seg_gyr_z_3 = segment_gyr_z.segment(2 * segment_size, segment_size);
      Eigen::VectorXf seg_gyr_z_4 = segment_gyr_z.segment(3 * segment_size, segment_size);

      Serial.println("seg_acc_x_1:");
      for (int i = 0; i < seg_acc_x_1.size(); i++) {
        Serial.println(seg_acc_x_1(i));  // 将小数点后的位数设置为4位
      }
      for (int i = 0; i < seg_acc_x_4.size(); i++) {
        Serial.println(seg_acc_x_4(i));  // 将小数点后的位数设置为4位
      }
      Serial.println("seg_acc_x over");
      // for (int i = 0; i < segment.size(); i++) {
      //   Serial.println(segment(i));  // 将小数点后的位数设置为4位
      // }
      // Serial.println("col0 print over");
      Eigen::VectorXf result_acc_x_1 = matrix48 * seg_acc_x_1;
      Eigen::VectorXf result_acc_x_2 = matrix48 * seg_acc_x_2;
      Eigen::VectorXf result_acc_x_3 = matrix48 * seg_acc_x_3;
      Eigen::VectorXf result_acc_x_4 = matrix48 * seg_acc_x_4;
      Serial.println("calculate1");

      Eigen::VectorXf result_acc_y_1 = matrix48 * seg_acc_y_1;
      Eigen::VectorXf result_acc_y_2 = matrix48 * seg_acc_y_2;
      Eigen::VectorXf result_acc_y_3 = matrix48 * seg_acc_y_3;
      Eigen::VectorXf result_acc_y_4 = matrix48 * seg_acc_y_4;
      Serial.println("calculate2");

      Eigen::VectorXf result_acc_z_1 = matrix48 * seg_acc_z_1;
      Eigen::VectorXf result_acc_z_2 = matrix48 * seg_acc_z_2;
      Eigen::VectorXf result_acc_z_3 = matrix48 * seg_acc_z_3;
      Eigen::VectorXf result_acc_z_4 = matrix48 * seg_acc_z_4;
      Serial.println("calculate3");

      Eigen::VectorXf result_gyr_x_1 = matrix48 * seg_gyr_x_1;
      Eigen::VectorXf result_gyr_x_2 = matrix48 * seg_gyr_x_2;
      Eigen::VectorXf result_gyr_x_3 = matrix48 * seg_gyr_x_3;
      Eigen::VectorXf result_gyr_x_4 = matrix48 * seg_gyr_x_4;
      Serial.println("calculate4");

      Eigen::VectorXf result_gyr_y_1 = matrix48 * seg_gyr_y_1;
      Eigen::VectorXf result_gyr_y_2 = matrix48 * seg_gyr_y_2;
      Eigen::VectorXf result_gyr_y_3 = matrix48 * seg_gyr_y_3;
      Eigen::VectorXf result_gyr_y_4 = matrix48 * seg_gyr_y_4;
      Serial.println("calculate5");

      Eigen::VectorXf result_gyr_z_1 = matrix48 * seg_gyr_z_1;
      Eigen::VectorXf result_gyr_z_2 = matrix48 * seg_gyr_z_2;
      Eigen::VectorXf result_gyr_z_3 = matrix48 * seg_gyr_z_3;
      Eigen::VectorXf result_gyr_z_4 = matrix48 * seg_gyr_z_4;
      Serial.println("calculate6");

      Eigen::VectorXf result_acc_x_combine(192);  // 定义一个长度为192的向量
      Eigen::VectorXf result_acc_y_combine(192);  // 定义一个长度为192的向量
      Eigen::VectorXf result_acc_z_combine(192);  // 定义一个长度为192的向量
      Eigen::VectorXf result_gyr_x_combine(192);  // 定义一个长度为192的向量
      Eigen::VectorXf result_gyr_y_combine(192);  // 定义一个长度为192的向量
      Eigen::VectorXf result_gyr_z_combine(192);  // 定义一个长度为192的向量
      Serial.println("calculate7");
      result_acc_x_combine.segment(0, 48) = result_acc_x_1;
      result_acc_x_combine.segment(48, 48) = result_acc_x_2;
      result_acc_x_combine.segment(96, 48) = result_acc_x_3;
      result_acc_x_combine.segment(144, 48) = result_acc_x_4;

      result_acc_y_combine.segment(0, 48) = result_acc_y_1;
      result_acc_y_combine.segment(48, 48) = result_acc_y_2;
      result_acc_y_combine.segment(96, 48) = result_acc_y_3;
      result_acc_y_combine.segment(144, 48) = result_acc_y_4;

      result_acc_z_combine.segment(0, 48) = result_acc_z_1;
      result_acc_z_combine.segment(48, 48) = result_acc_z_2;
      result_acc_z_combine.segment(96, 48) = result_acc_z_3;
      result_acc_z_combine.segment(144, 48) = result_acc_z_4;

      result_gyr_x_combine.segment(0, 48) = result_gyr_x_1;
      result_gyr_x_combine.segment(48, 48) = result_gyr_x_2;
      result_gyr_x_combine.segment(96, 48) = result_gyr_x_3;
      result_gyr_x_combine.segment(144, 48) = result_gyr_x_4;

      result_gyr_y_combine.segment(0, 48) = result_gyr_y_1;
      result_gyr_y_combine.segment(48, 48) = result_gyr_y_2;
      result_gyr_y_combine.segment(96, 48) = result_gyr_y_3;
      result_gyr_y_combine.segment(144, 48) = result_gyr_y_4;

      result_gyr_z_combine.segment(0, 48) = result_gyr_z_1;
      result_gyr_z_combine.segment(48, 48) = result_gyr_z_2;
      result_gyr_z_combine.segment(96, 48) = result_gyr_z_3;
      result_gyr_z_combine.segment(144, 48) = result_gyr_z_4;


      Serial.println("calculate8");

      for (int i = 0; i < result_gyr_z_combine.size(); ++i) {
        Serial.print(result_gyr_z_combine[i]);
        Serial.println(" ");
      }





      //       Serial.println("final compressed:");
      //       for (int i = 0; i < result_final.rows(); ++i) {
      //         for (int j = 0; j < result_final.cols(); ++j) {
      //           Serial.print(result_final(i, j));
      //           Serial.print(" ");  // 用空格分隔每一列
      //         }
      //         Serial.println();  // 换行到下一行
      //       }
      // 在这里，你可以对result进行你想要的操作，例如打印它：
      // for (int i = 0; i < result.size(); i++) {
      //   Serial.println(result(i),4);
      // }

      long endhaha_time = millis();

      Serial.println("calculation time is :");
      Serial.println(endhaha_time);
      Serial.println(starthaha_time);





      SD.begin(27);

      Serial.println("write successfully...");
      Serial.println(sd_filename);
      my_sd_File = SD.open("sdasd.csv", FILE_WRITE);

      if (my_sd_File) {

        for (int i = 0; i < result_gyr_z_combine.size(); ++i) {
          my_sd_File.print(result_gyr_z_combine[i]);
          if (i < result_gyr_z_combine.size() - 1) {
            my_sd_File.print("\n");  // 在元素之间添加逗号
          }
        }
        my_sd_File.close();  // 关闭文件
      }
    }

    prevTime_T4 = currentTime;

    if (compressive_sensing_control == 0) {
      //haha, i dont do any thing here, good luck.
    }

    if (compressive_sensing_control == 1) {
      automatical_time_interval_counter++;
      gyr_detecter = gyr_detecter + abs(gyr_z);
      if (automatical_time_interval_counter == 5) {
        gyr_detecter = gyr_detecter / 5;  // 玄学，如果这里没有除法，写入文件不会出错
        gyr_detecter = (int)gyr_detecter;

        automatical_time_interval_curve(gyr_detecter);
        automatical_time_interval_counter = 0;
        gyr_detecter = 0;
      }
    }
    if (compressive_sensing_control == 2) {
      automatical_time_interval_counter++;
      gyr_detecter = gyr_detecter + abs(gyr_z);
      if (automatical_time_interval_counter == 5) {
        gyr_detecter = gyr_detecter / 5;  // 玄学，如果这里没有除法，写入文件不会出错
        gyr_detecter = (int)gyr_detecter;

        automatical_time_interval_fast(gyr_detecter);
        automatical_time_interval_counter = 0;
        gyr_detecter = 0;
      }
    }
  }
}

void Sht40_Setup() {
  pinMode(24, OUTPUT);
  digitalWrite(24, HIGH);
  pinMode(9, INPUT_PULLUP);
  pinMode(10, INPUT_PULLUP);

  Wire.begin();



  delay(10);
  Serial.println("sht40 initialization setup finished...");
}
void Sht40_Action_Callback() {
  float* sht_data = sht.get_data_float();  // 获取数据，返回一个指向包含温度和湿度值的浮点数数组的指针, cpp必须使用static，不然读出来全是0
  Serial.print("Temperature: ");
  Serial.print(sht_data[0]);
  Serial.print(", Humidity: ");
  Serial.print(sht_data[1]);
  Serial.println("%");
}
void NRFSetup_Callback() {
  GPIO_Initiation();
  pinMode(13, OUTPUT);  // LED输出

  pinMode(14, OUTPUT);
  pinMode(15, OUTPUT);
  pinMode(27, OUTPUT);

  pinMode(22, OUTPUT);  //打开IC开关
  digitalWrite(22, HIGH);

  pinMode(23, OUTPUT);  //打开IC开关
  digitalWrite(23, HIGH);

  pinMode(24, OUTPUT);  //打开IC开关
  digitalWrite(24, HIGH);





  BMI_Setup();


  Sht40_Setup();
}

void BMI_Setup() {
  // if (BMI_init_status != 1) { // 我发现BMI初始化放在这里最好，因为修改模式和初始化完全无关，我刚开始是放在BMI_ADXL_Action里面的，这导致第一次使用的时候很慢，要等待初始化完成，但是放在这里的话
  //                         // 在我配置手机蓝牙的时候，它自己就开始初始化了，我点START之后立马开始运行了，这样好得多
  // 绝了 ，这里配置不信，导致BMI只会输出acc数据，gyr一直为0，但是放在setup_callback就没事。  我最后妥协了，在nrfsetup callback里面呼叫了这个函数，变成顺序执行
  //   while (1) {
  //     BMISetup();
  //     if (BMI_init_status == 1) {
  //       break;
  //     }
  //   }
  // }

  // adxl.Initialization(adxl_slaveSelectPin);

  if (BMI_init_status != 1) {  // 我发现BMI初始化放在这里最好，因为修改模式和初始化完全无关，我刚开始是放在BMI_ADXL_Action里面的，这导致第一次使用的时候很慢，要等待初始化完成，但是放在这里的话
                               // 在我配置手机蓝牙的时候，它自己就开始初始化了，我点START之后立马开始运行了，这样好得多
    while (1) {
      BMI_8kb_upload();
      if (BMI_init_status == 1) {
        break;
      }
    }
  }
  digitalWrite(13, HIGH);
  Serial.println("BMI initialization set up finished...");
}


void GPIO_Initiation() {
  //SPI 上拉电阻
  // pinMode(6, INPUT_PULLUP);
  // pinMode(7, INPUT_PULLUP);
  // pinMode(8, INPUT_PULLUP);
  // pinMode(14, INPUT_PULLUP);  //CS BMI
  // pinMode(15, INPUT_PULLUP);  //CS ADXL
  // pinMode(27, INPUT_PULLUP);
  //I2C 上拉电阻
  //pinMode(9, INPUT_PULLUP);
  //pinMode(10, INPUT_PULLUP);
  pinMode(9, OUTPUT);
  digitalWrite(9, LOW);
  pinMode(10, OUTPUT);  //我发现不用吧i2c的时候必须要给低电平，不然i2c会导致sht40的shtvcc引脚有3V的电压
  digitalWrite(10, LOW);


  //DISABLE IC SWITCH
  pinMode(22, OUTPUT);
  digitalWrite(22, LOW);
  pinMode(23, OUTPUT);
  digitalWrite(23, LOW);
  pinMode(24, OUTPUT);
  digitalWrite(24, LOW);
  pinMode(25, OUTPUT);
  digitalWrite(25, LOW);

  //DISABLE BMI INT
  pinMode(4, OUTPUT);
  digitalWrite(4, LOW);
  pinMode(5, OUTPUT);
  digitalWrite(5, LOW);


  pinMode(26, OUTPUT);
  digitalWrite(26, LOW);
  pinMode(28, OUTPUT);
  digitalWrite(28, LOW);
  pinMode(31, OUTPUT);  //IR OUT
  digitalWrite(31, LOW);
}

void BLESetup_Callback() {



  // create service

  blePeripheral.setLocalName("My NRF Device");
  blePeripheral.setAdvertisedServiceUuid(sensorConfigService.uuid());

  // add service and characteristic
  blePeripheral.addAttribute(sensorConfigService);
  blePeripheral.addAttribute(bmi_pwr_Characteristic);
  blePeripheral.addAttribute(acc_range_Characteristic);
  blePeripheral.addAttribute(gyr_range_Characteristic);
  blePeripheral.addAttribute(bmi_hz_Characteristic);
  blePeripheral.addAttribute(compressive_sensing_Characteristic);
  blePeripheral.addAttribute(data_compression_Characteristic);
  blePeripheral.addAttribute(te_hu_Characteristic);
  blePeripheral.addAttribute(infrared_Characteristic);



  blePeripheral.addAttribute(Start_Service);
  blePeripheral.addAttribute(Start_Characteristic);
  // begin initialization


  blePeripheral.begin();


  Serial.println(F("BLE waits to be connected..."));


  delay(5);
}




void BMI_8kb_upload() {
  SPI.begin();

  SPI.setDataMode(SPI_MODE3);
  //SPI.setBitOrder(MSBFIRST);
  delay(50);
  // SPI 4MHz
  SPI.setClockDivider(SPI_CLOCK_DIV2);

  //Dummy data
  SPI.transfer(0xFF);
  //Software Reset
  bmi2xx.writeRegister(CMD, 0xB6);
  delay(100);

  // Initialization Phase A.
  // Dummy
  bmi2xx.readRegister(0x00, 2);
  // BMI_chip_ID = bmi2xx.readRegister(CHIPID, 2);
  // Serial.print("BMI_chip_ID  = ");
  // Serial.println(BMI_chip_ID);

  BMI_power_mode = bmi2xx.readRegister(PWR_CONF, 2);
  // Serial.print("BMI_power_mode  = ");
  // Serial.println(BMI_power_mode);

  // Initialization Phase B.
  // disalbe POWER save mode
  // it was supposed to be 0x00
  bmi2xx.writeRegister(PWR_CONF, 0x0);
  //wait > 450us
  delay(1);

  //prepare config load INIT_CTRL = 0x00
  bmi2xx.writeRegister(INIT_CTRL, 0x00);

  //load config file and save as array
  config_size = sizeof(bmi2xx_config_file);

  if (config_size != CONFIG_SIZE) {
    Serial.println("Please put proper config file");
    while (1)
      ;
  }

  file_count = 0;

  byte* filepos = (byte*)bmi2xx_config_file;

  while (config_size > 0) {
    bmi2xx.Upload_file(config_size, file_count, filepos);

    filepos += 32;
    file_count++;
    config_size -= 32;
    delay(1);
  }

  //complete config load INIT_CTRL = 0x01
  bmi2xx.writeRegister(INIT_CTRL, 0x01);

  //Wait >= 140
  delay(150);

  // Initialization Phase C - Checking the correct initialization status
  BMI_init_status = bmi2xx.readRegister(INT_STATUS, 2);
  // Should be 1
  Serial.print("BMI_init_status  = ");
  Serial.println(BMI_init_status);
  //最原始代码有lidumode的时候，更改模式是放在这个最后位置的，我也放这里。 我发现放这里不行，以为运行中就无法改变了，以为这个BMISETUP只运行一次。
}

void config_all_sensors() {

  bmi_pwr_control = received_config_from_ble[0];

  acc_range_control = received_config_from_ble[1];
  gyr_range_control = received_config_from_ble[2];


  bmi_acc_config = received_config_from_ble[3];
  bmi_gyr_config = received_config_from_ble[3];

  compressive_sensing_control = received_config_from_ble[4];
  data_compression_control = received_config_from_ble[5];



  te_hu_control = received_config_from_ble[6];

  infrared_control = received_config_from_ble[7];


  Serial.println(gyr_range_control);
  bmi2xx.customized_mode_bmi(bmi_pwr_control, bmi_acc_config, bmi_gyr_config, acc_range_control, gyr_range_control);
  motion_sensor_inteval_set(bmi_acc_config);  //  不同的采样率要对应不同的数据速率
  sht.customized_mode_sht40(te_hu_control);
}
void motion_sensor_inteval_set(uint8_t bmi_hz_configure) {
  if (bmi_hz_configure == 0x05) {
    motion_sensor_time_interval = 79;
  }
  if (bmi_hz_configure == 0x06) {
    motion_sensor_time_interval = 39;
  }
  if (bmi_hz_configure == 0x07) {
    motion_sensor_time_interval = 19;
  }
  if (bmi_hz_configure == 0x08) {
    motion_sensor_time_interval = 9;
  }
  if (bmi_hz_configure == 0x09) {
    motion_sensor_time_interval = 4;
  }
  if (bmi_hz_configure == 0x0a) {
    motion_sensor_time_interval = 2;  // should be 2.5, but egal, not important
  }
  interval_T4_BMI270 = motion_sensor_time_interval;
  Serial.println("interval");
  Serial.println(motion_sensor_time_interval);
}

// void automatical_time_interval(int16_t x, int16_t y, int16_t z) {

void automatical_time_interval_fast(int x) {
  int testnumer = x;
  //int testnumer = abs(x) + abs(y) + abs(z);
  Serial.print("testnumer:");
  Serial.print(testnumer);
  Serial.println("");
  if (testnumer <= 100) {
    motion_sensor_time_interval = 99;
  }
  if (testnumer >= 101 && testnumer <= 500) {
    motion_sensor_time_interval = 79;
  }
  if (testnumer >= 501 && testnumer <= 1000) {
    motion_sensor_time_interval = 59;
  }
  if (testnumer >= 1001 && testnumer <= 2000) {
    motion_sensor_time_interval = 39;
  }
  if (testnumer >= 2001 && testnumer <= 3000) {
    motion_sensor_time_interval = 19;
  }
  if (testnumer >= 3001) {
    motion_sensor_time_interval = 9;
  }
  interval_T4_BMI270 = motion_sensor_time_interval;
  //delay(10);
}

void automatical_time_interval_curve(int x) {
  int testnumer = x;
  //int testnumer = abs(x) + abs(y) + abs(z);
  Serial.print("testnumer:");
  Serial.print(testnumer);
  Serial.println("");
  if (testnumer > 2000) {
    if (motion_sensor_time_interval > 10) {
      motion_sensor_time_interval = motion_sensor_time_interval - 10;
    }
  } else if (testnumer < 2000) {
    if (motion_sensor_time_interval < 100) {
      motion_sensor_time_interval = motion_sensor_time_interval + 10;
    }
  }
  interval_T4_BMI270 = motion_sensor_time_interval;
  //delay(10);
}
